## app/boards/my_board/Kconfig.my_board
```kconfig
config BOARD_MY_BOARD
    select SOC_STM32F746XX
    select BOARD_EARLY_INIT_HOOK
```

## app/boards/my_board/board.yml
```yaml
board:
  name: my_board
  full_name: My Board
  vendor: iomico
  socs:
    - name: stm32f746xx
```

## boards/our_board/Kconfig.our_board
```kconfig
# Copyright (c) 2018 Yurii Hamann
# SPDX-License-Identifier: Apache-2.0

config BOARD_OUR_BOARD
	select SOC_STM32F746XX
```

## boards/our_board/board.yml
```yaml
board:
  name: our_board
  full_name: Our Board
  vendor: iomico
  socs:
    - name: stm32f746xx
```

## tests/ring_buf/twister-out/native_sim_native/host/Desktop/zephyr-course/tests/ring_buf/homework.unit.ring_buf/Kconfig/arch/Kconfig.tmp
```kconfig
# Load Zephyr Arch Kconfig descriptions.
osource "/home/abdullah/zephyr/arch/rx/Kconfig"
osource "/home/abdullah/zephyr/arch/x86/Kconfig"
osource "/home/abdullah/zephyr/arch/xtensa/Kconfig"
osource "/home/abdullah/zephyr/arch/sparc/Kconfig"
osource "/home/abdullah/zephyr/arch/riscv/Kconfig"
osource "/home/abdullah/zephyr/arch/posix/Kconfig"
osource "/home/abdullah/zephyr/arch/mips/Kconfig"
osource "/home/abdullah/zephyr/arch/arm64/Kconfig"
osource "/home/abdullah/zephyr/arch/arm/Kconfig"
osource "/home/abdullah/zephyr/arch/arc/Kconfig"
```

## tests/ring_buf/twister-out/native_sim_native/host/Desktop/zephyr-course/tests/ring_buf/homework.unit.ring_buf/Kconfig/boards/Kconfig.defconfig
```kconfig
# Load Zephyr board defconfig descriptions.
osource "/home/abdullah/zephyr/boards/native/native_sim/Kconfig.defconfig"
```

## tests/ring_buf/twister-out/native_sim_native/host/Desktop/zephyr-course/tests/ring_buf/homework.unit.ring_buf/Kconfig/boards/Kconfig.native_sim.tmp
```kconfig
# Load board Kconfig descriptions.
osource "/home/abdullah/zephyr/boards/native/native_sim/Kconfig.native_sim"
```

## tests/ring_buf/twister-out/native_sim_native/host/Desktop/zephyr-course/tests/ring_buf/homework.unit.ring_buf/Kconfig/boards/Kconfig.sysbuild.tmp
```kconfig
# Load Sysbuild board Kconfig descriptions.
osource "/home/abdullah/zephyr/boards/native/native_sim/Kconfig.sysbuild"
```

## tests/ring_buf/twister-out/native_sim_native/host/Desktop/zephyr-course/tests/ring_buf/homework.unit.ring_buf/Kconfig/boards/Kconfig.tmp
```kconfig
# Load Zephyr board Kconfig descriptions.
osource "/home/abdullah/zephyr/boards/native/native_sim/Kconfig"
```
